## meta-esme-custom/conf/layer.conf
```bitbake
# We have a conf and classes directory, add to BBPATH
BBPATH .= ":${LAYERDIR}"

# We have recipes-* directories, add to BBFILES
BBFILES += "${LAYERDIR}/recipes-*/*/*.bb \
            ${LAYERDIR}/recipes-*/*/*.bbappend"

BBFILE_COLLECTIONS += "meta-esme-custom"
BBFILE_PATTERN_meta-esme-custom = "^${LAYERDIR}/"
BBFILE_PRIORITY_meta-esme-custom = "50"

LAYERDEPENDS_meta-esme-custom = "core raspberrypi"
LAYERSERIES_COMPAT_meta-esme-custom = "scarthgap"
```

## meta-esme-images/conf/layer.conf
```bitbake
# We have a conf and classes directory, add to BBPATH
BBPATH .= ":${LAYERDIR}"

# We have recipes-* directories, add to BBFILES
BBFILES += "${LAYERDIR}/recipes-*/*/*.bb \
            ${LAYERDIR}/recipes-*/*/*.bbappend"

BBFILE_COLLECTIONS += "meta-esme-images"
BBFILE_PATTERN_meta-esme-images = "^${LAYERDIR}/"
BBFILE_PRIORITY_meta-esme-images = "60"

LAYERDEPENDS_meta-esme-images = "core raspberrypi"
LAYERSERIES_COMPAT_meta-esme-images = "scarthgap"
```
